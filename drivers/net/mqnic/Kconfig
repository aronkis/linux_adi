## drivers/net/mqnic/Kconfig
```kconfig
# SPDX-License-Identifier: BSD-2-Clause-Views
# Copyright (c) 2019-2023 The Regents of the University of California

menuconfig CORUNDUM_MQNIC
	tristate "Corundum MQNIC support"
	help
	  Corundum is an open-source, FPGA-based Network Interface Card (NIC)
	  and platform designed for high-performance networking and in-network
	  compute applications.

	  Say yes here to build support for Corundum network interface card.
```
